## components/audio_backend/Kconfig
```kconfig
menu "Audio Backend Configuration"

    choice AUDIO_BACKEND_SDMMC_BUS_WIDTH
        prompt "SDMMC bus width"
        default AUDIO_BACKEND_SDMMC_BUS_WIDTH_4
        help
            Select the preferred SDMMC bus width for card initialization.
            4-bit is faster, 1-bit is more tolerant with marginal wiring.

        config AUDIO_BACKEND_SDMMC_BUS_WIDTH_4
            bool "4-bit (D0-D3)"

        config AUDIO_BACKEND_SDMMC_BUS_WIDTH_1
            bool "1-bit (D0 only)"
    endchoice

    config AUDIO_BACKEND_SDMMC_TRY_1BIT_FALLBACK
        bool "Fallback to 1-bit when preferred width fails"
        default y
        depends on AUDIO_BACKEND_SDMMC_BUS_WIDTH_4
        help
            If initial mount fails in 4-bit mode, retry once in 1-bit mode.

    config AUDIO_BACKEND_SDMMC_MAX_FREQ_KHZ
        int "SDMMC max frequency (kHz)"
        range 400 40000
        default 20000
        help
            Maximum transfer frequency after card init. Probing still starts
            at low speed.

    config AUDIO_BACKEND_SDMMC_FORMAT_IF_MOUNT_FAILED
        bool "Format SD card if mount fails"
        default n
        help
            If enabled, card will be partitioned/formatted as FAT when mount
            fails. WARNING: this erases card content.

if SOC_SDMMC_IO_POWER_EXTERNAL

    config AUDIO_BACKEND_SDMMC_USE_INTERNAL_LDO
        bool "Use internal LDO power control for SD IO"
        default y if IDF_TARGET_ESP32P4
        default n
        help
            Enable this when the board powers SD IO from an internal LDO
            (common with ESP32-P4 default high-speed SDMMC pins).

    config AUDIO_BACKEND_SDMMC_LDO_CHANNEL_ID
        int "Internal LDO channel ID"
        depends on AUDIO_BACKEND_SDMMC_USE_INTERNAL_LDO
        default 4 if IDF_TARGET_ESP32P4
        default 4

endif

    config AUDIO_BACKEND_WIFI_STA_SSID
        string "Wi-Fi STA SSID (upload mode)"
        default ""
        help
            Station SSID used by the built-in upload web server.
            If empty, Wi-Fi upload mode cannot start.

    config AUDIO_BACKEND_WIFI_STA_PASSWORD
        string "Wi-Fi STA password (upload mode)"
        default ""
        help
            Station password used by upload mode.

    config AUDIO_BACKEND_WIFI_CONNECT_TIMEOUT_MS
        int "Wi-Fi connect timeout (ms)"
        range 1000 60000
        default 12000
        help
            Maximum time to wait for STA connection before failing.

    config AUDIO_BACKEND_WIFI_HTTP_PORT
        int "Upload web server port"
        range 1 65535
        default 80
        help
            HTTP server port for story upload UI/API.

endmenu
```

## main/Kconfig.projbuild
```kconfig
menu "Basmio Board Diagnostics"

    config SPOD_C6_DEBUG_BRIDGE
        bool "Boot into ESP32-C6 UART debug bridge"
        default n
        help
            Starts a raw bridge between the ESP32-P4 USB console and the
            ESP32-C6 UART0 pins. This is a diagnostic mode; normal UI/audio
            startup is skipped while it is enabled.

    config SPOD_C6_DEBUG_BRIDGE_UART_PORT
        int "P4 UART port for C6 bridge"
        depends on SPOD_C6_DEBUG_BRIDGE
        range 0 4
        default 1

    config SPOD_C6_DEBUG_BRIDGE_BAUDRATE
        int "C6 UART baudrate"
        depends on SPOD_C6_DEBUG_BRIDGE
        range 9600 3000000
        default 115200
        help
            ESP32 ROM and bootloader logs normally use 115200 baud.

    config SPOD_C6_DEBUG_BRIDGE_P4_TX_GPIO
        int "P4 TX GPIO connected to C6_U0RXD"
        depends on SPOD_C6_DEBUG_BRIDGE
        range 0 54
        default 11

    config SPOD_C6_DEBUG_BRIDGE_P4_RX_GPIO
        int "P4 RX GPIO connected to C6_U0TXD"
        depends on SPOD_C6_DEBUG_BRIDGE
        range 0 54
        default 12

    config SPOD_C6_DEBUG_BRIDGE_C6_BOOT_GPIO
        int "P4 GPIO connected to C6 GPIO9/BOOT (-1 unused)"
        depends on SPOD_C6_DEBUG_BRIDGE
        range -1 54
        default 13

    config SPOD_C6_DEBUG_BRIDGE_C6_RESET_GPIO
        int "P4 GPIO connected to C6 reset/CHIP_PU (-1 unused)"
        depends on SPOD_C6_DEBUG_BRIDGE
        range -1 54
        default 54

    config SPOD_C6_DEBUG_BRIDGE_RESET_ON_START
        bool "Reset C6 when bridge starts"
        depends on SPOD_C6_DEBUG_BRIDGE
        default y

    config SPOD_C6_DEBUG_BRIDGE_FORCE_BOOTLOADER
        bool "Hold C6 GPIO9 low during reset"
        depends on SPOD_C6_DEBUG_BRIDGE
        default n
        help
            Enable only when you want the C6 ROM download bootloader instead
            of the currently installed firmware boot log.

endmenu
```

## sdkconfig.defaults
```kconfig
# BasmioTwo - ESP32-S3 / JC3248W535EN defaults
CONFIG_IDF_TARGET="esp32s3"
CONFIG_ESPTOOLPY_FLASHSIZE_16MB=y
CONFIG_PARTITION_TABLE_CUSTOM=y
CONFIG_PARTITION_TABLE_MD5=n
CONFIG_SPIRAM=y
CONFIG_SPIRAM_MODE_OCT=y
CONFIG_SPIRAM_SPEED_80M=y
CONFIG_SPIRAM_MALLOC_ALWAYSINTERNAL=4096
CONFIG_FREERTOS_TASK_CREATE_ALLOW_EXT_MEM=y
CONFIG_SPIRAM_ALLOW_STACK_EXTERNAL_MEMORY=y
CONFIG_ESP_SYSTEM_EVENT_TASK_STACK_SIZE=4096
CONFIG_ESP_MAIN_TASK_STACK_SIZE=8192
CONFIG_FATFS_LFN_HEAP=y
CONFIG_FATFS_API_ENCODING_UTF_8=y
CONFIG_LWIP_TCP_OOSEQ_MAX_PBUFS=4
CONFIG_LWIP_TCPIP_TASK_STACK_SIZE=6144
CONFIG_AUDIO_BACKEND_SDMMC_BUS_WIDTH_1=y
CONFIG_AUDIO_BACKEND_SDMMC_TRY_1BIT_FALLBACK=n
CONFIG_AUDIO_BACKEND_SDMMC_MAX_FREQ_KHZ=20000
CONFIG_AUDIO_BACKEND_WIFI_STA_SSID=""
CONFIG_AUDIO_BACKEND_WIFI_STA_PASSWORD=""
CONFIG_LV_MEM_CUSTOM=y
CONFIG_LV_COLOR_16_SWAP=y
CONFIG_LV_DITHER_GRADIENT=y
CONFIG_LV_IMG_CACHE_DEF_SIZE=2
CONFIG_LV_FONT_MONTSERRAT_16=y
CONFIG_LV_FONT_MONTSERRAT_18=y
CONFIG_LV_FONT_MONTSERRAT_20=y
CONFIG_LV_FONT_MONTSERRAT_22=y
CONFIG_LV_FONT_MONTSERRAT_24=y
CONFIG_LV_FONT_MONTSERRAT_28=y
CONFIG_LV_FONT_MONTSERRAT_30=y
CONFIG_LV_FONT_MONTSERRAT_32=y
CONFIG_LV_FONT_MONTSERRAT_48=y
CONFIG_LV_FONT_FMT_TXT_LARGE=y
CONFIG_LV_USE_FS_STDIO=y
CONFIG_LV_FS_STDIO_LETTER=83
CONFIG_LV_USE_PNG=y
CONFIG_LV_USE_BMP=y
CONFIG_LV_USE_SJPG=y
CONFIG_LV_USE_LINE=y
CONFIG_LV_USE_TEXTAREA=y
CONFIG_LV_USE_KEYBOARD=y
CONFIG_AUDIO_DECODER_MP3_SUPPORT=y
# CONFIG_AUDIO_DECODER_AAC_SUPPORT is not set
# CONFIG_AUDIO_DECODER_FLAC_SUPPORT is not set
# CONFIG_AUDIO_DECODER_OPUS_SUPPORT is not set

CONFIG_SPIRAM_TRY_ALLOCATE_WIFI_LWIP=y
CONFIG_SPIRAM_ALLOW_BSS_SEG_EXTERNAL_MEMORY=y
CONFIG_ESP_WIFI_STATIC_RX_BUFFER_NUM=6
CONFIG_ESP_WIFI_DYNAMIC_RX_BUFFER_NUM=12
CONFIG_LWIP_TCPIP_RECVMBOX_SIZE=16
CONFIG_LWIP_MAX_LISTENING_TCP=4
CONFIG_LWIP_MAX_UDP_PCBS=8
CONFIG_MBEDTLS_EXTERNAL_MEM_ALLOC=y
CONFIG_NVS_ALLOCATE_CACHE_IN_SPIRAM=y

# Performance (step 1)
CONFIG_COMPILER_OPTIMIZATION_PERF=y
CONFIG_ESP_DEFAULT_CPU_FREQ_MHZ_240=y
CONFIG_ESPTOOLPY_FLASHMODE_QIO=y
CONFIG_LWIP_MAX_SOCKETS=12
CONFIG_LWIP_MAX_ACTIVE_TCP=16
CONFIG_LWIP_TCP_SND_BUF_DEFAULT=16384
CONFIG_LWIP_TCP_WND_DEFAULT=16384
CONFIG_LWIP_TCP_RECVMBOX_SIZE=16
# CONFIG_LV_USE_PERF_MONITOR is not set
CONFIG_FREERTOS_USE_TRACE_FACILITY=y
CONFIG_FREERTOS_GENERATE_RUN_TIME_STATS=y

# Wi-Fi: with SPIRAM_TRY_ALLOCATE_WIFI_LWIP only static TX buffers are allowed (~1.6 KB internal each);
# 8 instead of 16 saves ~13 KB, bursts overflow into the PSRAM cache queue (ESP_WIFI_CACHE_TX_BUFFER_NUM)
CONFIG_ESP_WIFI_STATIC_TX_BUFFER=y
CONFIG_ESP_WIFI_STATIC_TX_BUFFER_NUM=8
```
